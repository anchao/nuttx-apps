## benchmarks/coremark/Kconfig
```kconfig
#
# For a description of the syntax of this configuration file,
# see the file kconfig-language.txt in the NuttX tools repository.
#

menuconfig BENCHMARK_COREMARK
	bool "Coremark Benchmark"
	default n
	---help---
		Enable support for the EEMBC's Coremark benchmark application.

if BENCHMARK_COREMARK

config COREMARK_PROGNAME
	string "Coremark program name"
	default "coremark"
	---help---
		This is the name of the program that will be used when the NSH ELF
		program is installed.

config COREMARK_PRIORITY
	int "Coremark task priority"
	default 100

config COREMARK_STACKSIZE
	int "Coremark task stack size"
	default 4096

config COREMARK_ITERATIONS
	int "Coremark iterations loop counter"
	default 0

config COREMARK_SEED_METHOD
	int "Coremark Seed Method"
	default 2
	---help---
		Set Coremark Seed Method:
		0: SEED_ARG
		1: SEED_FUNC
		2: SEED_VOLATILE

config COREMARK_MEM_METHOD
	int "Coremark Memory Method"
	default 1
	---help---
		Set Coremark Memory Method:
		0: MEM_STATIC
		1: MEM_MALLOC
		2: MEM_STACK

config COREMARK_DEBUG
	int "Coremark Core Debug"
	default 0
	---help---
		Enable the Core Debug:
		0: Disable
		1: Enable

config COREMARK_RUN_METHOD
	int "Coremark Run Method"
	default 0
	---help---
		Enable the Run Method:
		0: VALIDATION_RUN
		1: PERFORMANCE_RUN
		2: PROFILE_RUN

config COREMARK_MEM_LOCATION
	string "Coremark memory location string"
	default "Defined by the NuttX configuration"

config COREMARK_MULTITHREAD_OVERRIDE
	bool "Override number of threads"
	default n
	---help---
		Override the default number of threads to be executed.
		The default value is the same as the number of CPU cores.

config COREMARK_MULTITHREAD_COUNT
	depends on COREMARK_MULTITHREAD_OVERRIDE
	int "Number of threads to be executed"
	default 1

config COREMARK_ITERATIONS_OVERRIDE
	bool "Override number of iterations"
	default n
	---help---
		Override the default number of iterations for the benchmark.
		The default value is defined by the application based on the system.

config COREMARK_ITERATIONS_COUNT
	depends on COREMARK_ITERATIONS_OVERRIDE
	int "Number of iterations"
	default 100

endif # BENCHMARK_COREMARK
```

## graphics/lvgl/lv_porting/gpu_manager/Kconfig
```kconfig
#
# For a description of the syntax of this configuration file,
# see the file kconfig-language.txt in the NuttX tools repository.
#

menuconfig LV_USE_GPU_MANAGER
	bool "GPU Manager"
	default n

if LV_USE_GPU_MANAGER

source "$APPSDIR/graphics/lvgl/lv_porting/gpu_manager/vg_lite/Kconfig"

config LV_GPU_USE_ARM_MVE
	bool "ARM MVE Draw Context"
	depends on ARM_HAVE_MVE && LV_COLOR_DEPTH = 32
	default y

config LV_GPU_MANAGER_USE_LOG
	bool "Log Output"
	default y

config LV_GPU_MANAGER_USE_PERF
	bool "Performance Measurement"
	default n

endif # LV_USE_GPU_MANAGER
```

## graphics/lvgl/lv_porting/gpu_manager/vg_lite/Kconfig
```kconfig
#
# For a description of the syntax of this configuration file,
# see the file kconfig-language.txt in the NuttX tools repository.
#

menuconfig LV_GPU_USE_VG_LITE
	bool "VGLite Draw Context"
	default n

if LV_GPU_USE_VG_LITE

config LV_GPU_VG_LITE_INCLUDE
	string "VGLite header include path"
	default ""

config LV_GPU_VG_LITE_ARC
	bool "VGLite draw arc"
	default y

config LV_GPU_VG_LITE_BG
	bool "VGLite draw background"
	default y

config LV_GPU_VG_LITE_IMG_DECODED
	bool "VGLite draw image decoded"
	default y

config LV_GPU_VG_LITE_LINE
	bool "VGLite draw line"
	default n

config LV_GPU_VG_LITE_POLYGON
	bool "VGLite draw polygon"
	default y

config LV_GPU_VG_LITE_RECT
	bool "VGLite draw rectangle"
	default y

config LV_GPU_VG_LITE_CHECK_DRAW_MASK
	bool "VGLite check draw mask"
	default n

config LV_GPU_VG_LITE_DRAW_AREA_MIN_SIZE
	int "VGLite draw area min size"
	default 0

config LV_GPU_VG_LITE_TRANSFORM_MIN_SIZE
	int "VGLite transform min size"
	default 0

config LV_GPU_VG_LITE_IMG_EXPAND_SIZE
	int "VGLite image decoder expand size"
	default 0

config LV_GPU_VG_LITE_IMG_SRC_PX_ALIGN
	int "VGLite image source align pixel"
	default 16

config LV_GPU_VG_LITE_IMG_SRC_SOFT_PREMULTIPLIED
	bool "VGLite image source software premultiplied"
	default y

config LV_GPU_VG_LITE_LVGL_BLEND_SUPPORT
	bool "VGLite LVGL Blend support"
	default n

config LV_GPU_VG_LITE_CUSTOM_INIT
	bool "VGLite custom init function"
	default y

endif # LV_GPU_USE_VG_LITE
```

## osi/autosar/Kconfig
```kconfig
#
# For a description of the syntax of this configuration file,
# see the file kconfig-language.txt in the NuttX tools repository.
#

config AUTOSAR
	tristate "\"Hello, World!\" example"
	default n
	---help---
		Enable the \"Hello, World!\" example

if AUTOSAR

config AUTOSAR_PROGNAME
	string "Program name"
	default "autosar"
	---help---
		This is the name of the program that will be used when the NSH ELF
		program is installed.

config AUTOSAR_PRIORITY
	int "Hello task priority"
	default 100

config AUTOSAR_STACKSIZE
	int "Hello stack size"
	default DEFAULT_TASK_STACKSIZE

endif
```

## testing/gpu/Kconfig
```kconfig
#
# For a description of the syntax of this configuration file,
# see the file kconfig-language.txt in the NuttX tools repository.
#

menuconfig TESTING_GPU
	tristate "GPU Test"
	default n

if TESTING_GPU

config TESTING_GPU_PRIORITY
	int "Task priority"
	default 100

config TESTING_GPU_STACKSIZE
	int "Stack size"
	default 32768

config TESTING_GPU_VG_LITE_INCLUDE
	string "VGLite header include path"
	default ""

config TESTING_GPU_VG_LITE_CUSTOM_INIT
	bool "VGLite custom init function"
	default y

endif # TESTING_GPU
```
